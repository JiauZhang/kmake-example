## arch/Kconfig
```kconfig
choice
    prompt "choice architecture"
    default ARCH_ARM

config ARCH_ARM
    bool "select arm architecture"

config ARCH_X86
    bool "select x86 architecture"

config ARCH_MIPS
    bool "select mips architecture"

endchoice

source "arch/$(ARCH)/Kconfig"
```

## arch/arm/Kconfig
```kconfig
config ARM_BOOL
	bool "kmake-example arm_bool configuration"
	default y
	help
	  This is a kmake-example of arm_bool configuration test.

config ARM_TRISTATE
	tristate "kmake-example arm_tristate configuration"
	default y
	help
	  This is a kmake-example of arm_tristate configuration test.

config ARM_STRING
	string "kmake-example arm_string configuration"
	default "hello"
	help
	  This is a kmake-example of arm_string configuration test.

config ARM_HEX
	hex "kmake-example arm_hex configuration"
	default 0xdeadbeef
	help
	  This is a kmake-example of arm_hex configuration test.

config ARM_INT
	int "kmake-example arm_int configuration"
	default 123456
	help
	  This is a kmake-example of arm_int configuration test.
```

## arch/x86/Kconfig
```kconfig
config X86_BOOL
	bool "kmake-example x86_bool configuration"
	default y
	help
        This is a kmake-example of x86_bool configuration test.

config X86_TRISTATE
	tristate "kmake-example x86_tristate configuration"
	default y
	help
        This is a kmake-example of x86_tristate configuration test.

config X86_STRING
	string "kmake-example x86_string configuration"
	default "hello"
	help
        This is a kmake-example of x86_string configuration test.

config X86_HEX
	hex "kmake-example x86_hex configuration"
	default 0xdeadbeef
	help
        This is a kmake-example of x86_hex configuration test.

config X86_INT
	int "kmake-example x86_int configuration"
	default 123456
	help
        This is a kmake-example of x86_int configuration test.
```
